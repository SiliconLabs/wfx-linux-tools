/include/ "wfx-spi-overlay.dts"

/ {
        fragment@2 {
                __overlay__ {
                        wfx: spidev@0 {
                                compatible = "silabs,wfx-spi", "spidev";
                        };
                };
        };
};
