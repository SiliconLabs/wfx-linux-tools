/dts-v1/;
/plugin/;

/ {
	compatible = "brcm,bcm2708";

	fragment@0 {
		target = <&gpio>;
		__overlay__ {
			uart0_pins: uart0_gpios {
				brcm,pins = <14 15>;
				brcm,function = <0 0>;
				brcm,pull = <0 0>;
			};
		};
	};

	fragment@1 {
		target = <&uart0>;
		__overlay__ {
			pinctrl-names = "default";
			pinctrl-0 = <&uart0_pins>;
		};
	};

};
